// Libraries
#include <Wire.h>
#include <Adafruit_PWMServoDriver.h>
#include <AccelStepper.h>

// Physical Bot Characteristics:
#define LEFT_LIMIT_SWTICH_RELATIVE_TO_A0 196
#define RIGHT_LIMIT_SWTICH_RELATIVE_TO_A0 1544
#define STEPPER_TICK_PER_KEY 2.3 * 1000 / 61.5
#define LEFT_KEY_DOWN_SERVO 614
#define LEFT_KEY_UP_SERVO 245
#define RIGHT_KEY_DOWN_SERVO 614
#define RIGHT_KEY_UP_SERVO 220

// limit switch connections, any digital pins will do.
#define LEFT_LIMIT_SWITCH_PIN 8
#define RIGHT_LIMIT_SWITCH_PIN 9

// stepper motor connections, any digital pins will do.
#define LEFT_STEPPER_DIRECTION_PIN 2
#define LEFT_STEPPER_STEP_PIN 3
#define RIGHT_STEPPER_DIRECTION_PIN 4
#define RIGHT_STEPPER_STEP_PIN 5
#define LEFT_STEPPER_ENABLE 10
#define RIGHT_STEPPER_ENABLE 11

// PCA settings
#define nbPCAServo 16

// Connect both pca driver to same scl sda pins.
// Define PCA addressing
#define LEFT_PCA_ADDRESS 0x40
#define RIGHT_PCA_ADDRESS 0x41

// stepper motor settings and steps per revolution
#define motorInterfaceType 1
#define pulserate 8000
#define accelrate 8000

// Global Objects
Adafruit_PWMServoDriver pcal = Adafruit_PWMServoDriver(LEFT_PCA_ADDRESS);
Adafruit_PWMServoDriver pcar = Adafruit_PWMServoDriver(RIGHT_PCA_ADDRESS);

AccelStepper stepperl = AccelStepper(motorInterfaceType, LEFT_STEPPER_STEP_PIN, LEFT_STEPPER_DIRECTION_PIN);
AccelStepper stepperr = AccelStepper(motorInterfaceType, RIGHT_STEPPER_STEP_PIN, RIGHT_STEPPER_DIRECTION_PIN);

bool stepperl_on = true;
bool stepperr_on = true;


// extra note,
// the stepper motor for the left hand is actually placed on the right side.
// for positive counter, it moves the left hand to the left.
// the stepper motor for the right hand is actually placed on the left side.
// for positive counter, it moves the right hand to the right.

// song data are put into the following 3 integer arrays
// comment out example arrays once copy in the actual instructions
// eg:
// INSERT_INSTRUCTION_HERE
const PROGMEM int song_inst_count = 1994;
const PROGMEM long song_time[] ={ 0, 0, 2000, 2000, 2000, 2000, 2375, 2500, 2750, 2875, 3125, 3250, 3500,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 309125, 309125 };
const PROGMEM int song_sync[] ={ 0, 1, 7, 6, 2, 3, 7, 5, 7, 5, 7, 5, 7,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 4, 4 };
const PROGMEM int song_args[] ={ 299, 748, 1, 3, 0, 0, 7, 1, 10, 7, 1, 10, 7,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 15, 7 };



void setup()
{

    // Init Serial USB
    Serial.begin(9600);
    Serial.println(F("Initialize System"));
    // Init stepper driver
    pinMode(LEFT_STEPPER_ENABLE,OUTPUT);
    digitalWrite(LEFT_STEPPER_ENABLE,HIGH);
    stepperl.setMaxSpeed(pulserate);
    stepperl.setAcceleration(accelrate);

    
    pinMode(RIGHT_STEPPER_ENABLE,OUTPUT);
    digitalWrite(RIGHT_STEPPER_ENABLE,HIGH);
    stepperr.setMaxSpeed(pulserate);
    stepperr.setAcceleration(accelrate);
    
    
    // Init PCA/servo driver
    pcal.begin();
    pcal.setPWMFreq(60);
    pcar.begin();
    pcar.setPWMFreq(60);

    // Init limit switch.
    pinMode(LEFT_LIMIT_SWITCH_PIN, INPUT_PULLUP);
    pinMode(RIGHT_LIMIT_SWITCH_PIN, INPUT_PULLUP);

    // Init on board LED
    pinMode(LED_BUILTIN, OUTPUT);

    // indicate it
    Serial.print("Initialization Complete\n");
}

void loop()
{
    Serial.print("Loop Begin\n");
    resetServo();
    resetStepper();
    playSong();
}

void resetServo()
{
    // Lift All Fingers
    Serial.print("Reseting Servo Motors on left hand\n");
    for (int i = 0; i < nbPCAServo; i++)
    {
        pcal.setPWM(i, 0, LEFT_KEY_DOWN_SERVO);
        delay(300);
        pcal.setPWM(i, 0, LEFT_KEY_UP_SERVO);
    }
    delay(500);
    // Turn them all to not powered state. (potential auto reset, need to check)
    for (int i = 0; i < nbPCAServo; i++)
    {
        pcal.setPWM(i, 0, 0);
    }
    // repeat for the other hand
    Serial.print("Reseting Servo Motors on right hand\n");
    for (int i = 0; i < nbPCAServo; i++)
    {
        pcar.setPWM(i, 0, RIGHT_KEY_DOWN_SERVO);
        delay(300);
        pcar.setPWM(i, 0, RIGHT_KEY_UP_SERVO);
    }
    delay(500);
    for (int i = 0; i < nbPCAServo; i++)
    {
        pcar.setPWM(i, 0, 0);
    }
}

void resetStepper()
{
    int counter = 0;
    // reset main stepper motor
    Serial.print("Reseting Left Stepper Motors\n");
    stepperl.enableOutputs();
    stepperl_on=true;
    stepperl.setSpeed(-pulserate);
    stepperl.moveTo(4000); // this largest number of steps before hitting the end. calculated from 2 meter and 100 step per 6 cm.
    while (1)
    {
        stepperl.run(); // non-blocking operation, no delay required.
        if (digitalRead(LEFT_LIMIT_SWITCH_PIN) == LOW)
        {
            counter += 1;
        }
        else
        {
            counter = 0;
        }
        Serial.print(counter);
        if (counter >= 5)
        {
            break;
        }
    }
    Serial.print("\n");
    stepperl.setCurrentPosition(LEFT_LIMIT_SWTICH_RELATIVE_TO_A0);

    Serial.print("Reseting Right Stepper Motors\n");
    counter = 0;
    stepperr.enableOutputs();
    stepperr_on=true;
    stepperr.setSpeed(-pulserate);
    stepperr.moveTo(4000); // this largest number of steps before hitting the end. calculated from 2 meter and 100 step per 6 cm.
    while (1)
    {
        stepperr.run(); // non-blocking operation, no delay required.
        if (digitalRead(RIGHT_LIMIT_SWITCH_PIN) == LOW)
        {
            counter += 1;
        }
        else
        {
            counter = 0;
        }
        Serial.print(counter);
        if (counter >= 5)
        {
            break;
        }
    }
    Serial.print("\n");
    stepperr.setCurrentPosition(RIGHT_LIMIT_SWTICH_RELATIVE_TO_A0);
}

void playSong()
{
    Serial.print("Starting pLaying the song.\n");
    int instruction_index = 0;
    int tick = millis();
    while (instruction_index < song_inst_count)
    {
        digitalWrite(LED_BUILTIN, !digitalRead(LED_BUILTIN));
        if (millis() - tick >= pgm_read_dword_near(song_time + instruction_index))
        {
            int support_arg = pgm_read_word_near(song_args + instruction_index);
            switch (pgm_read_word_near(song_sync + instruction_index))
            {
            case 0:
                /* move left hand to x*/
                Serial.print("left to");
                stepperl_on = true;
                stepperl.enableOutputs();
                digitalWrite(LEFT_STEPPER_ENABLE,HIGH);
                stepperl.moveTo(-(support_arg - 87));
                break;
            case 1:
                /* move right hand to x*/
                Serial.print("right to ");
                stepperr_on = true;
                stepperr.enableOutputs();
                digitalWrite(RIGHT_STEPPER_ENABLE,HIGH);
                stepperr.moveTo((support_arg - 87));
                break;
            case 2:
                /* move left hand to x*/
                Serial.print("left stop");
                stepperr_on = false;
                stepperl.disableOutputs();
                digitalWrite(LEFT_STEPPER_ENABLE,LOW);
                break;
            case 3:
                /* move right hand to x*/
                Serial.print("right stop");
                stepperl_on = false;
                stepperr.disableOutputs();
                digitalWrite(RIGHT_STEPPER_ENABLE,LOW);
                break;
            case 4:
                /* release x key of left hand */
                pcal.setPWM(support_arg, 0, LEFT_KEY_UP_SERVO);
                break;
            case 5:
                /* release x key of right hand */
                pcar.setPWM(support_arg, 0, RIGHT_KEY_UP_SERVO);
                break;
            case 6:
                /* press x key of left hand */
                pcal.setPWM(support_arg, 0, LEFT_KEY_DOWN_SERVO);
                break;
            case 7:
                /* press x key of right hand */
                pcar.setPWM(support_arg, 0, RIGHT_KEY_DOWN_SERVO);
                break;
            }
            instruction_index++;
        }
        if (stepperl_on) {
          stepperl.run();
        }
        if (stepperr_on) {
          stepperr.run();
        }
        delayMicroseconds(500);
    }
}
